## sdkconfig.defaults
```kconfig
CONFIG_IDF_TARGET="esp32s3"
CONFIG_ESPTOOLPY_FLASHSIZE_32MB=y
CONFIG_PARTITION_TABLE_SINGLE_APP_LARGE=y
CONFIG_SPIRAM=y
CONFIG_SPIRAM_MODE_OCT=y
CONFIG_SPIRAM_SPEED_80M=y
CONFIG_ESP_MAIN_TASK_STACK_SIZE=8192
CONFIG_FREERTOS_HZ=1000
CONFIG_GPIO_CTRL_FUNC_IN_IRAM=y
CONFIG_ESP_CONSOLE_SECONDARY_NONE=y
CONFIG_IDF_EXPERIMENTAL_FEATURES=y

# Calculator is entirely local: do not include radio/network stacks by default.
CONFIG_ESP_WIFI_ENABLED=n
CONFIG_BT_ENABLED=n
CONFIG_ETH_ENABLED=n
CONFIG_ESP_PHY_ENABLED=n
CONFIG_ESP_COEX_ENABLED=n
```
